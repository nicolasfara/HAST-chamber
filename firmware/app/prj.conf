## CMakeLists.txt
```
# SPDX-License-Identifier: Apache-2.0

cmake_minimum_required(VERSION 3.20.0)

find_package(Zephyr REQUIRED HINTS $ENV{ZEPHYR_BASE})
project(hast_chamber)

target_sources(app PRIVATE src/main.c)
```

## west.yml
```
# West manifest for the HAST chamber firmware (application as manifest repository).
# Initialize the workspace from firmware/: `west init -l app && west update`
manifest:
  remotes:
    - name: zephyrproject-rtos
      url-base: https://github.com/zephyrproject-rtos

  projects:
    - name: zephyr
      remote: zephyrproject-rtos
      revision: v4.5.0
      import:
        # Only fetch the modules needed by the ESP32-S3; extend when adding features.
        name-allowlist:
          - hal_espressif
          - mbedtls
          - mcuboot

  self:
    path: app
```

## prj.conf
```kconfig
# Application configuration shared by all boards.
# Board-specific options go in boards/<board>.conf.

CONFIG_LOG=y
CONFIG_LOG_DEFAULT_LEVEL=3
```

## src/main.c
```c
/*
 * SPDX-License-Identifier: Apache-2.0
 */

#include <zephyr/kernel.h>
#include <zephyr/logging/log.h>
#include <zephyr/app_version.h>

LOG_MODULE_REGISTER(main, LOG_LEVEL_INF);

#define HEARTBEAT_PERIOD_MS 1000

int main(void)
{
	LOG_INF("HAST chamber firmware v%s on %s", APP_VERSION_STRING, CONFIG_BOARD_TARGET);

	while (1) {
		LOG_INF("uptime: %lld ms", k_uptime_get());
		k_msleep(HEARTBEAT_PERIOD_MS);
	}

	return 0;
}
```
